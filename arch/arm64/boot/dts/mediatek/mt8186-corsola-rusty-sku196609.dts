// SPDX-License-Identifier: (GPL-2.0 OR MIT)
/*
 * Copyright 2022 Google LLC
 */

/dts-v1/;
#include "mt8186-corsola-steelix.dtsi"

/ {
	model = "Google Rusty sku196609 board";
	compatible = "google,steelix-sku196609", "google,steelix", "mediatek,mt8186";
};

&gpio_keys {
	status = "disabled";
};

&fibocom_wwan_fm101 {
	status = "disabled";
};

&touchscreen {
	status = "disabled";
};
